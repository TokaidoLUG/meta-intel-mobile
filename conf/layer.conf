## conf/layer.conf
```bitbake
# We have a conf and classes directory, add to BBPATH
BBPATH .= ":${LAYERDIR}"

# We have recipes-* directories, add to BBFILES
BBFILES += "${LAYERDIR}/recipes-*/*/*.bb \
            ${LAYERDIR}/recipes-*/*/*.bbappend"

BBFILE_COLLECTIONS += "intel-mobile"
BBFILE_PATTERN_intel-mobile := "^${LAYERDIR}/"
BBFILE_PRIORITY_intel-mobile = "7"


# This should only be incremented on significant changes that will
# cause compatibility issues with other layers
LAYERVERSION_intel-mobile = "3"
```

## conf/machine/intel-64.conf
```bitbake
#@TYPE: Machine
#@NAME: intel-64

#@DESCRIPTION: Machine configuration for 64 bit Intel Core i7 CPU (and later) with MMX, SSE, SSE2, SSE3, and SSSE3 instruction set support. Supports a moderately wide range of drivers that should boot and be usable on "typical" hardware.

require conf/machine/intel-corei7-64.conf

MACHINE_EXTRA_RRECOMMENDS += " grub-efi systemd-boot "

EFI_PROVIDER = "grub-efi"
```

## conf/machine/intel-mobile-64.conf
```bitbake
#@TYPE: Machine
#@NAME: intel-mobile-64

#@DESCRIPTION: Machine configuration for 64 bit Intel Core i7 CPU (and later) with MMX, SSE, SSE2, SSE3, and SSSE3 instruction set support. Supports a moderately wide range of drivers that should boot and be usable on "typical" hardware.

require conf/machine/intel-corei7-64.conf

require conf/multilib.conf

MULTILIBS = "multilib:lib32"
DEFAULTTUNE_virtclass-multilib-lib32 = "x86"

MACHINE_EXTRA_RRECOMMENDS += " lib32-grub-efi lib32-systemd-boot "

EFI_PROVIDER = "grub-efi"

# workaround of lib32 locale install failer
MACHINE_EXTRA_RRECOMMENDS += " lib32-glibc-locale "
```
